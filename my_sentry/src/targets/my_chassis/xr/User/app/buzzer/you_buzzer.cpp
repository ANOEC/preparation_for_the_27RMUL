#include "app/buzzer/you_buzzer.hpp"

#include <algorithm>
#include <iterator>

namespace UserApp::Buzzer
{

// 由参考工程 Buzzer-YOU/BSP/buzzer.c 的 gala_you() 逐项迁移。
// 参考工程以 200 ms 为一拍；这里预先换算成毫秒，0 Hz 表示休止符。
const YouBuzzer::NoteEvent YouBuzzer::SCORE[] = {
    {494,200}, {392,200}, {494,400}, {392,200}, {494,400}, {392,200},
    {587,400}, {392,200}, {523,200}, {523,200}, {392,200}, {494,200},
    {523,200}, {494,200}, {392,200}, {494,400}, {392,200}, {494,400},
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    {330,800}, {294,800},
};

const std::size_t YouBuzzer::SCORE_SIZE = std::size(SCORE);

YouBuzzer::YouBuzzer(LibXR::PWM& pwm, std::size_t thread_stack,
                     LibXR::Thread::Priority priority)
    : pwm_(pwm)
{
  REQUIRE(thread_stack > 0);
  thread_.Create(this, ThreadEntry, "you_buzzer", thread_stack, priority);
}

void YouBuzzer::Play()
{
  restart_requested_.store(true);
  playing_.store(true);
}

void YouBuzzer::Stop()
{
  playing_.store(false);
}

bool YouBuzzer::IsPlaying() const
{
  return playing_.load();
}

LibXR::ErrorCode YouBuzzer::LastError() const
{
  return last_error_.load();
}

void YouBuzzer::ThreadEntry(YouBuzzer* self)
{
  REQUIRE(self != nullptr);
  self->Run();
}

void YouBuzzer::Run()
{
  std::size_t index = 0;
  Silence();

  while (true)
  {
    if (!playing_.load())
    {
      index = 0;
      LibXR::Thread::Sleep(CONTROL_GRANULARITY_MS);
      continue;
    }

    if (restart_requested_.exchange(false))
    {
      index = 0;
    }

    if (index >= SCORE_SIZE)
    {
      Silence();
      playing_.store(false);
      index = 0;
      continue;
    }

    const NoteEvent event = SCORE[index++];
    if (!Output(event))
    {
      Silence();
      playing_.store(false);
      index = 0;
      continue;
    }

    uint32_t remaining_ms = event.duration_ms;
    while (remaining_ms > 0 && playing_.load() && !restart_requested_.load())
    {
      const uint32_t sleep_ms = std::min(remaining_ms, CONTROL_GRANULARITY_MS);
      LibXR::Thread::Sleep(sleep_ms);
      remaining_ms -= sleep_ms;
    }

    if (!playing_.load())
    {
      Silence();
      index = 0;
    }
  }
}

bool YouBuzzer::Output(const NoteEvent& event)
{
  if (!StoreResult(pwm_.SetDutyCycle(0.0F)))
  {
    return false;
  }

  if (event.frequency_hz == 0)
  {
    return true;
  }

  if (!StoreResult(pwm_.SetConfig({event.frequency_hz})))
  {
    return false;
  }
  if (!StoreResult(pwm_.SetDutyCycle(0.5F)))
  {
    return false;
  }
  return StoreResult(pwm_.Enable());
}

void YouBuzzer::Silence()
{
  static_cast<void>(pwm_.SetDutyCycle(0.0F));
  static_cast<void>(pwm_.Disable());
}

bool YouBuzzer::StoreResult(LibXR::ErrorCode result)
{
  last_error_.store(result);
  return result == LibXR::ErrorCode::OK;
}

}  // namespace UserApp::Buzzer
